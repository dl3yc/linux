## drivers/iio/amplifiers/Kconfig
```kconfig
#
# Gain Amplifiers, etc.
#
# When adding new entries keep the list in alphabetical order

menu "Amplifiers"

config AD8366
	tristate "Analog Devices AD8366 VGA"
	depends on SPI
	select BITREVERSE
	help
	  Say yes here to build support for Analog Devices AD8366
	  SPI Dual-Digital Variable Gain Amplifier (VGA).

	  To compile this driver as a module, choose M here: the
	  module will be called ad8366.

config PGA2310
	tristate "Burr Brown PGA2310"
	depends on SPI
        help
          Say yes here to build support for Burr Brown PGA2310
          SPI Stereo Audio Volume Control.

          To compile this driver as a module, choose M here: the
          module will be called pga2310.

endmenu
```
